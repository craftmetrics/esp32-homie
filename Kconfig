## Kconfig
```kconfig
menu "Homie HTTP client"

    config ESP_HTTP_CLIENT_ENABLE_HTTPS
        bool "Enable https"
        default y
        help
            This option will enable https protocol by linking mbedtls library
            and initializing SSL transport
    choice HOMIE_VERSION
        bool "Homie Convention version"
        default HOMIE_VERSION_4_0_0
        config HOMIE_VERSION_4_0_0
            bool "4.0.0"
        help
            The version of Homie Convention.

            Currently supported versions:
              * 4.0.0
    endchoice
    config HOMIE_MAX_MQTT_TOPIC_LEN
        int "Max length of MQTT topic"
        default 512
        help
            Maximum length, including NULL termination, of MQTT topic.
    config HOMIE_MAX_MQTT_DATA_LEN
        int "Max length of data part of MQTT message"
        default 256
        help
            Maximum length of data part of MQTT message.
    config HOMIE_MAX_MQTT_CLIENT_ID_LEN
        int "Max length of MQTT client ID"
        default 32
        help
            Maximum length, including NULL termination, of MQTT client ID.
    config HOMIE_MAX_MQTT_BASE_TOPIC_LEN
        int "Max length of MQTT base topic"
        default 32
        help
            Maximum length, including NULL termination, of MQTT base topic.
    config HOMIE_MAX_DEVICE_NAME_LEN
        int "Max length of device name"
        default 32
        help
            Maximum length, including NULL termination, of device name.
    config HOMIE_MAX_FIRMWARE_NAME_LEN
        int "Max length of firmware name"
        default 32
        help
            Maximum length, including NULL termination, of firmware name.
    config HOMIE_MAX_FIRMWARE_VERSION_LEN
        int "Max length of firmware version"
        default 32
        help
            Maximum length, including NULL termination, of firmware version.
    config HOMIE_MAX_NODE_LISTS_LEN
        int "Max length of node_lists"
        default 64
        help
            Maximum length, including NULL termination, of node_lists.
    config HOMIE_MAX_LOG_MESSAGE_LEN
        int "Max length of log message"
        default 256
        help
            Maximum length, including NULL termination, of log message.

            This value must equal to, or be more than, HOMIE_MAX_MQTT_DATA_LEN.
endmenu
```

## examples/esp32-homie-example/main/Kconfig.projbuild
```kconfig
menu "ESP32 Homie Example"

config WIFI_SSID
    string "WiFi SSID"
    default "myssid"
    help
        SSID (network name) to connect to.

config WIFI_PASSWORD
    string "WiFi Password"
    default "mypassword"
    help
        WiFi password (WPA or WPA2).

config MQTT_URI
    string "MQTT Broker URI"
    default "mqtt://test.example.org:1883"
    help
        URI to the MQTT broker.

config MQTT_USERNAME
    string "MQTT Username"
    default "user"
    help
        Username for connecting to the MQTT broker.

config MQTT_PASSWORD
    string "MQTT Password"
    default "password"
    help
        Password for connecting to the MQTT broker.
config OTA_URL
    string "URI to firmware"
    default "http://example.org/build/example.bin"
    help
        URI to the firmware
config EXAMPLE_MQTT_LOGGER_ENABLE
    bool "Enable or disable MQTT logger"
    default false
    help
        when true, Enable MQTT logger. All logs will be logged to MQTT logger topic
config EXAMPLE_MQTT_LOGGER_TOPIC
    string "MQTT logger topic"
    default "foo/bar/buz/logger"
    help
        MQTT topic to log.
endmenu
```

## examples/esp32-homie-example/sdkconfig.defaults.esp8266
```kconfig
CONFIG_PARTITION_TABLE_TWO_OTA=y
CONFIG_MQTT_USING_ESP=y
CONFIG_MQTT_PROTOCOL_311=y
```
